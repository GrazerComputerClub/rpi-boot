/*
 * Device Tree overlay for SPI TFT LCD with ILI9341 chip 320x240 (2,2-2,8") 
 *
 */

/dts-v1/;
/plugin/;

/ {
	compatible = "brcm,bcm2835", "brcm,bcm2708", "brcm,bcm2709";

	fragment@0 {
		target = <&spi0>;
		__overlay__ {
			status = "okay";

			spidev@0{
				status = "disabled";
			};

		};
	};

	fragment@1 {
		target = <&spi0>;
		__overlay__ {
			/* needed to avoid dtc warning */
			#address-cells = <1>;
			#size-cells = <0>;

			fb_ili9341@0{
				compatible = "ilitek,ili9341";
				reg = <0>;
				pinctrl-names = "default";

				name = "fb_ili9341";
				spi-max-frequency = <82000000>;
				rotate = <90>;
				buswidth = <8>;
				bgr = <1>;
				fps = <50>;
				height = <320>;
				width = <240>;
				reset-gpios = <&gpio 25 0>;
				dc-gpios = <&gpio 24 0>;
				cs-gpios = <&gpio 8 0>;
				debug = <0>;
			};
		};
	};
};


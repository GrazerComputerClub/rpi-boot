/*
 * Device Tree overlay for Waveshare 1.44" TFT LCD HAT 128x128
 *
 */

/dts-v1/;
/plugin/;

/ {
	compatible = "brcm,bcm2835", "brcm,bcm2708", "brcm,bcm2709";

	fragment@0 {
		target = <&spi0>;
		__overlay__ {
			status = "okay";

			spidev@0{
				status = "disabled";
			};

		};
	};

	fragment@1 {
		target = <&spi0>;
		__overlay__ {
			/* needed to avoid dtc warning */
			#address-cells = <1>;
			#size-cells = <0>;

			waveshare144@0{
				compatible = "ilitek,ili9163";
				reg = <0>;
				pinctrl-names = "default";

				name = "waveshare144";
				spi-max-frequency = <48000000>;
				rotate = <90>;
				buswidth = <8>;
				fps = <50>;
				height = <128>;
				width = <128>;
				bgr;
				reset-gpios = <&gpio 27 0>;
				dc-gpios = <&gpio 25 0>;
				cs-gpios = <&gpio 8 0>;
				led-gpios = <&gpio 24 1>;
				debug = <0>;
			};
		};
	};
};

